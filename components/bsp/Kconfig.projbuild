## components/bsp/Kconfig.projbuild
```kconfig
menu "Board support"

config BSP_BOARD_CYD
    bool "ESP32-2432S028R Cheap Yellow Display"
    depends on IDF_TARGET_ESP32
    default y
    help
        Use the ESP32 CYD instead of the ESP32-C3 FoloToy AI Passport.

if BSP_BOARD_CYD

choice BSP_CYD_LCD
    prompt "CYD display controller"
    default BSP_CYD_LCD_ST7789
config BSP_CYD_LCD_ST7789
    bool "ST7789 (common dual USB revision)"
config BSP_CYD_LCD_ILI9341
    bool "ILI9341 (alternative CYD revision)"
endchoice

config BSP_CYD_LCD_BGR
    bool "BGR color order"
    default y
config BSP_CYD_LCD_INVERT
    bool "Invert display colors"
    default n
config BSP_CYD_LCD_SPI_MODE
    int "LCD SPI mode"
    range 0 3
    default 0
config BSP_CYD_LCD_MIRROR_X
    bool "Mirror display horizontally"
    default y if BSP_CYD_LCD_ST7789
config BSP_CYD_LCD_MIRROR_Y
    bool "Mirror display vertically"
    default n
config BSP_CYD_ROTATE_180
    bool "Rotate display and gestures 180 degrees"
    default n
    help
        Rotate both the corrected display and calibrated touch coordinates.
        The native panel mirror settings above remain independent.
config BSP_CYD_TOUCH_SWAP_XY
    bool "Swap touch axes"
    default y
config BSP_CYD_TOUCH_INVERT_X
    bool "Invert touch X axis"
    default y
config BSP_CYD_TOUCH_INVERT_Y
    bool "Invert touch Y axis"
    default n
config BSP_CYD_TOUCH_X_MIN
    int "Raw touch X minimum"
    range 0 4094
    default 200
config BSP_CYD_TOUCH_X_MAX
    int "Raw touch X maximum"
    range 1 4095
    default 3900
config BSP_CYD_TOUCH_Y_MIN
    int "Raw touch Y minimum"
    range 0 4094
    default 200
config BSP_CYD_TOUCH_Y_MAX
    int "Raw touch Y maximum"
    range 1 4095
    default 3900
config BSP_CYD_TOUCH_DEBUG
    bool "Log raw touch coordinates for calibration"
    default n

endif
endmenu
```

## main/Kconfig.projbuild
```kconfig
menu "Printer camera"
    config CAMERA_BUFFERED_PREVIEW
        bool "Buffer fitted RGB565 preview before presenting"
        depends on !BSP_BOARD_CYD || (!ESP_WIFI_IRAM_OPT && !ESP_WIFI_RX_IRAM_OPT)
        default y if BSP_BOARD_CYD
        default n
        help
            Decode and verify before updating the LCD in one short locked burst.
            Uses 32-bit RAM blocks, preferring unused IRAM on ESP32; no full JPEG
            or source-resolution RGB buffer. Disable WiFi IRAM optimizations in
            the CYD profile to leave enough RAM for networking alongside it.
    config CAMERA_STALE_MS
        int "Show Loading after no verified display update (ms)"
        range 1000 60000
        default 5000
    config CAMERA_REFRESH_DELAY_MS
        int "Delay after a verified camera snapshot (ms)"
        range 0 10000
        default 2000
        help
            This is added after transfer/decode/display time, not a frame period.
            Failures keep their separate backoff. Manual refresh skips this delay.
    config CAMERA_REUSE_SESSION
        bool "Reuse authenticated TLS session for JPEG snapshots"
        default n
        help
            Avoid a handshake per frame. Applies to the JPEG file-preview path;
            stream protocol models keep their existing reconnect behavior.
            Releases the connection on failure, page exit or printer change.
    config CAMERA_START_ON_SECOND_PAGE
        bool "Open camera page at startup (single printer, diagnostic builds)"
        default n
    config CAMERA_GEOMETRY_SELFTEST
        bool "Run camera geometry self-tests at boot"
        default n
        help
            Exercise 16:9, 4:3, portrait, small JPEGs, and pixel mapping on-device.
endmenu
```
